VERSION ""
NS_ :

BS_:
BU_: Demo
BO_ 256 DemoStatus: 8 Demo
 SG_ Counter : 0|8@1+ (1,0) [0|255] "" Demo
 SG_ Temperature : 8|8@1+ (1,-40) [-40|215] "degC" Demo
